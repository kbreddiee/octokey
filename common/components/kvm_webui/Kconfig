## common/components/kvm_webui/Kconfig
```kconfig
menu "espkvm phone web UI (kvm_webui)"

    config ESPKVM_AP_SSID
        string "Wi-Fi network name (SSID) the hub broadcasts"
        default "octokey"

    config ESPKVM_AP_PASSWORD
        string "Wi-Fi password (min 8 chars, blank = open network)"
        default "octokey-air"
        help
            This password is the ONLY thing standing between your phone's
            keystrokes and anyone else in range — unlike the hub<->dongle
            link (unique ephemeral keys per dongle), the phone<->hub hop
            is only as secure as ordinary WPA2. CHANGE THIS DEFAULT before
            relying on it anywhere you don't fully trust the room. See
            docs/SECURITY.md.

    config ESPKVM_AP_MAX_CLIENTS
        int "Max simultaneous phone connections"
        range 1 4
        default 2

endmenu
```

## firmware/dongle/main/Kconfig.projbuild
```kconfig
menu "espkvm dongle"

    config ESPKVM_CHANNEL
        int "ESP-NOW Wi-Fi channel (must match the hub)"
        range 1 13
        default 1

    config ESPKVM_LED_GPIO
        int "Status LED GPIO (-1 = no plain LED)"
        range -1 48
        default 15 if IDF_TARGET_ESP32S2
        default -1
        help
            GPIO15 is the onboard LED of the Lolin/Wemos S2 Mini.
            Boards whose only LED is addressable RGB (LILYGO T-Dongle-S3:
            APA102, M5Stack AtomS3U: WS2812) should keep -1; the T-Dongle
            uses its LCD for status instead.

    config ESPKVM_BTN_GPIO
        int "Pairing button GPIO"
        default 0
        help
            The onboard button used for pairing / factory reset.
              S2 Mini            : 0  (BOOT)
              LILYGO T-Dongle-S3 : 0  (BOOT)
              M5Stack AtomS3U    : 41 (front button)
            Short press: enter pairing mode. Hold 5 s: factory reset.

    config ESPKVM_LCD
        bool "ST7735 status LCD (LILYGO T-Dongle-S3)"
        default y if IDF_TARGET_ESP32S3
        default n
        help
            Drive the T-Dongle-S3's 160x80 LCD: shows this dongle's slot
            number, ACTIVE/idle state and link health. Harmless if enabled
            on an S3 board without the panel (writes go nowhere).

    if ESPKVM_LCD
        config ESPKVM_LCD_MOSI
            int "LCD MOSI (SDA) GPIO"
            default 3
        config ESPKVM_LCD_SCLK
            int "LCD SCLK GPIO"
            default 5
        config ESPKVM_LCD_CS
            int "LCD CS GPIO"
            default 4
        config ESPKVM_LCD_DC
            int "LCD D/C GPIO"
            default 2
        config ESPKVM_LCD_RST
            int "LCD RESET GPIO"
            default 1
        config ESPKVM_LCD_BL
            int "LCD backlight GPIO (active low)"
            default 38
    endif

endmenu
```

## firmware/hub-air/main/Kconfig.projbuild
```kconfig
menu "espkvm hub-air"

    config ESPKVM_CHANNEL
        int "ESP-NOW / AP Wi-Fi channel (must match the dongles)"
        range 1 13
        default 1
        help
            hub-air hosts its own Wi-Fi network for the phone AND runs
            ESP-NOW to the dongles on the same radio, so this single
            channel is both. It must match CONFIG_ESPKVM_CHANNEL on every
            dongle you pair (dongles auto-adopt the hub's channel at
            pairing time, so this only matters if you change it later).

            The AP SSID/password/client-limit options moved to the shared
            kvm_webui component (Component config -> espkvm phone web UI).

endmenu
```

## firmware/hub-dongle/main/Kconfig.projbuild
```kconfig
menu "espkvm hub-dongle"

    config ESPKVM_CHANNEL
        int "ESP-NOW / AP Wi-Fi channel (must match the dongles)"
        range 1 13
        default 1
        help
            hub-dongle hosts its own Wi-Fi network for the phone AND runs
            ESP-NOW to the other dongles on the same radio, so this single
            channel is both. Dongles auto-adopt the hub's channel at
            pairing time, so this only matters if you change it later.

            The AP SSID/password/client-limit options live in the shared
            kvm_webui component (Component config -> espkvm phone web UI).

    config ESPKVM_LOCAL_NAME
        string "Display name for the computer this stick is plugged into"
        default "this PC"
        help
            Shown in the phone web UI for the local slot (the machine the
            hub-dongle itself types into). Rename per machine if you build
            several images, or just leave it.

    config ESPKVM_BTN_GPIO
        int "Pairing button GPIO"
        default 0
        help
            The onboard button (BOOT on the LILYGO T-Dongle-S3). Short
            press: open the hub's 30 s pairing window for a new dongle
            (same as the phone UI's Pair button). Hold 5 s: factory reset
            (wipes all pairings + keys, reboots).

    config ESPKVM_LCD
        bool "ST7735 status LCD (LILYGO T-Dongle-S3)"
        default y
        help
            Drive the T-Dongle-S3's 160x80 LCD: the 0-9 slot bar, the
            Wi-Fi network + URL for the phone, and USB state. Disable on
            boards without the panel.

    if ESPKVM_LCD
        config ESPKVM_LCD_MOSI
            int "LCD MOSI (SDA) GPIO"
            default 3
        config ESPKVM_LCD_SCLK
            int "LCD SCLK GPIO"
            default 5
        config ESPKVM_LCD_CS
            int "LCD CS GPIO"
            default 4
        config ESPKVM_LCD_DC
            int "LCD D/C GPIO"
            default 2
        config ESPKVM_LCD_RST
            int "LCD RESET GPIO"
            default 1
        config ESPKVM_LCD_BL
            int "LCD backlight GPIO (active low)"
            default 38
    endif

endmenu
```

## firmware/hub-tdeck/main/Kconfig.projbuild
```kconfig
menu "espkvm hub-tdeck"

    config ESPKVM_CHANNEL
        int "ESP-NOW Wi-Fi channel (must match the dongles)"
        range 1 13
        default 1

    menu "Onboard peripherals (LILYGO official pin_config.h)"
        config ESPKVM_POWERON_GPIO
            int "Peripheral power-enable GPIO"
            default 10
        config ESPKVM_I2C_SDA
            int "Keyboard/touch I2C SDA GPIO"
            default 18
        config ESPKVM_I2C_SCL
            int "Keyboard/touch I2C SCL GPIO"
            default 8

        config ESPKVM_TBALL_UP
            int "Trackball UP GPIO"
            default 2
        config ESPKVM_TBALL_DOWN
            int "Trackball DOWN GPIO"
            default 3
        config ESPKVM_TBALL_LEFT
            int "Trackball LEFT GPIO"
            default 1
        config ESPKVM_TBALL_RIGHT
            int "Trackball RIGHT GPIO"
            default 15
        config ESPKVM_TBALL_CLICK
            int "Trackball center-click GPIO"
            default 0
            help
                Shared with BOOT — only matters at power-on/reset, safe to
                read as a normal button once the app is running (same
                pattern the T-Embed hub uses for its encoder click).

        config ESPKVM_LCD_CS
            int "LCD CS GPIO"
            default 12
        config ESPKVM_LCD_DC
            int "LCD D/C GPIO"
            default 11
        config ESPKVM_LCD_BL
            int "LCD backlight GPIO"
            default 42
        config ESPKVM_LCD_MOSI
            int "LCD MOSI GPIO"
            default 41
        config ESPKVM_LCD_MISO
            int "LCD MISO GPIO (shared SPI bus with SD/LoRa)"
            default 38
        config ESPKVM_LCD_SCLK
            int "LCD SCLK GPIO"
            default 40

        config ESPKVM_SD_CS
            int "SD card CS GPIO (shares the LCD SPI bus, parked high)"
            default 39
        config ESPKVM_RADIO_CS
            int "LoRa radio CS GPIO (shares the LCD SPI bus, parked high)"
            default 9
    endmenu

    menu "Trackball feel"
        config ESPKVM_TBALL_STEP
            int "Pixels moved per trackball pulse"
            range 1 20
            default 4
        config ESPKVM_HOTKEY_TAP_MS
            int "Max ms between the two Alt taps (hotkey chord)"
            default 400
        config ESPKVM_HOTKEY_CMD_TIMEOUT_MS
            int "Command-mode timeout (ms) waiting for the digit"
            default 2000
    endmenu

endmenu
```

## firmware/hub/main/Kconfig.projbuild
```kconfig
menu "espkvm hub"

    choice ESPKVM_HUB_BOARD
        prompt "Hub board"
        default ESPKVM_HUB_BOARD_DEVKIT
        help
            DevKit: ESP32-S3 DevKitC-1 with an external SSD1306 I2C OLED
            and EC11 rotary encoder (see docs/BUILD.md for wiring).
            T-Embed: LILYGO T-Embed — ST7789 LCD, rotary encoder and
            battery support all built in; zero wiring.

        config ESPKVM_HUB_BOARD_DEVKIT
            bool "ESP32-S3 DevKitC-1 + SSD1306 OLED + external encoder"
        config ESPKVM_HUB_BOARD_TEMBED
            bool "LILYGO T-Embed (built-in ST7789 + encoder)"
        config ESPKVM_HUB_BOARD_HEADLESS
            bool "espkvm custom PCB (button + 10 slot LEDs, no display)"
            help
                See hardware/hub-refdesign/. One button cycles/pairs, one
                LED per slot shows the active machine; per-slot detail is
                on the dongles' own screens.
    endchoice

    config ESPKVM_CHANNEL
        int "ESP-NOW Wi-Fi channel (must match the dongles)"
        range 1 13
        default 1

    config ESPKVM_PWR_EN_GPIO
        int "Peripheral power-enable GPIO (-1 = none)"
        default 46 if ESPKVM_HUB_BOARD_TEMBED
        default -1
        help
            Driven high at boot. The T-Embed gates its display/peripheral
            power (and battery boost) behind GPIO46.

    if !ESPKVM_HUB_BOARD_HEADLESS
        menu "Rotary encoder"
            config ESPKVM_ENC_A
                int "Encoder A GPIO"
                default 2 if ESPKVM_HUB_BOARD_TEMBED
                default 4
            config ESPKVM_ENC_B
                int "Encoder B GPIO"
                default 1 if ESPKVM_HUB_BOARD_TEMBED
                default 5
            config ESPKVM_ENC_SW
                int "Encoder push-button GPIO"
                default 0 if ESPKVM_HUB_BOARD_TEMBED
                default 6
        endmenu
    endif

    if ESPKVM_HUB_BOARD_HEADLESS
        config ESPKVM_HUB_BTN_GPIO
            int "Mode button GPIO"
            default 14
            help
                Short press: next slot. Hold 3 s: pairing mode.
                Triple-click then click: forget the active slot.
                Slot LED pins are the table in ui_headless.c
                (GPIO4..13 by default, matching hardware/hub-refdesign).
    endif

    if ESPKVM_HUB_BOARD_DEVKIT
        menu "OLED (SSD1306 128x64 I2C)"
            config ESPKVM_OLED_SDA
                int "SDA GPIO"
                default 8
            config ESPKVM_OLED_SCL
                int "SCL GPIO"
                default 9
            config ESPKVM_OLED_ADDR
                hex "I2C address"
                default 0x3C
        endmenu
    endif

    if ESPKVM_HUB_BOARD_TEMBED
        menu "T-Embed LCD (ST7789 320x170)"
            config ESPKVM_LCD_MOSI
                int "LCD MOSI GPIO"
                default 11
            config ESPKVM_LCD_SCLK
                int "LCD SCLK GPIO"
                default 12
            config ESPKVM_LCD_CS
                int "LCD CS GPIO"
                default 10
            config ESPKVM_LCD_DC
                int "LCD D/C GPIO"
                default 13
            config ESPKVM_LCD_RST
                int "LCD RESET GPIO"
                default 9
            config ESPKVM_LCD_BL
                int "LCD backlight GPIO (active high)"
                default 15
        endmenu
    endif

    menu "Hotkey chord"
        config ESPKVM_HOTKEY_TAP_MS
            int "Max ms between the two Right-Ctrl taps"
            default 400
        config ESPKVM_HOTKEY_CMD_TIMEOUT_MS
            int "Command-mode timeout (ms) waiting for the digit"
            default 2000
    endmenu

endmenu
```
